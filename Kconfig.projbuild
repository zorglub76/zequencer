## Kconfig.projbuild
```kconfig
# zequencer/Kconfig.projbuild

menu "Zequencer Configuration"

    config ZEQ_MIDI_UART_PORT
        int "MIDI UART port number"
        default 1
        range 1 2
        help
            UART port used for MIDI output (31250 baud).
            UART0 is reserved for the debug console.

    config ZEQ_MIDI_TX_GPIO
        int "MIDI TX GPIO pin"
        default 17
        range 0 39
        help
            GPIO pin connected to the MIDI output circuit TX line.

    config ZEQ_MIDI_DEFAULT_CHANNEL
        int "Default MIDI channel (1–16)"
        default 1
        range 1 16

    config ZEQ_SEQ_NUM_STEPS
        int "Number of sequencer steps"
        default 16
        range 8 64
        help
            Maximum steps in one pattern. Must be a power of 2.

    config ZEQ_SEQ_DEFAULT_BPM
        int "Default BPM at startup"
        default 120
        range 20 300

    config ZEQ_SEQ_DEFAULT_NOTE
        int "Default MIDI note number (0–127)"
        default 60
        help
            Middle C = 60. Used as the note for all active steps on startup.

    config ZEQ_BLE_POSITION_INTERVAL_MS
        int "BLE step-position feedback interval (ms)"
        default 50
        range 10 200
        help
            How often the current sequencer step position is broadcast
            over BLE to the controller application.

endmenu
```

## components/midi/Kconfig
```kconfig
menu "Zequencer MIDI settings"

config ZEQ_MIDI_UART_PORT
    int "UART port for MIDI output"
    default 1

config ZEQ_MIDI_TX_GPIO
    int "GPIO number for MIDI TX"
    default 17

endmenu
```

## components/sequencer/Kconfig
```kconfig
menu "Zequencer sequencer settings"

config ZEQ_SEQ_NUM_STEPS
    int "Number of steps in pattern"
    default 16

config ZEQ_SEQ_DEFAULT_BPM
    int "Default BPM for new patterns"
    default 120

config ZEQ_SEQ_DEFAULT_NOTE
    int "Default MIDI note for new steps"
    default 60

config ZEQ_MIDI_DEFAULT_CHANNEL
    int "Default MIDI channel (1-16)"
    default 1

endmenu
```

## sdkconfig.defaults
```kconfig
# zequencer/sdkconfig.defaults

# ── FreeRTOS ──────────────────────────────────────────────────────────────────
# 1 kHz tick for 1 ms resolution in timing-sensitive tasks
CONFIG_FREERTOS_HZ=1000
# Larger stack for the sequencer/BLE tasks
CONFIG_FREERTOS_IDLE_TASK_STACKSIZE=4096

# ── Bluetooth (NimBLE — lighter than Bluedroid, BLE-only) ────────────────────
CONFIG_BT_ENABLED=y
CONFIG_BT_NIMBLE_ENABLED=y
CONFIG_BT_CONTROLLER_MODE_BLE_ONLY=y
# Device name shown during BLE advertisement
CONFIG_BT_NIMBLE_SVC_GAP_DEVICE_NAME="Zequencer"
# Max simultaneous BLE connections (1 for a dedicated controller app)
CONFIG_BT_NIMBLE_MAX_CONNECTIONS=1
CONFIG_ZEQ_BLE_POSITION_INTERVAL_MS=50

# ── Logging ───────────────────────────────────────────────────────────────────
# Keep INFO level for development; set to WARN for release builds
CONFIG_LOG_DEFAULT_LEVEL_INFO=y
CONFIG_LOG_MAXIMUM_LEVEL_DEBUG=y

# ── UART / MIDI ───────────────────────────────────────────────────────────────
# Reserve UART1 for MIDI — UART0 stays for console/debug
CONFIG_ESP_CONSOLE_UART_NUM=0

# ── Flash / Partition table ───────────────────────────────────────────────────
CONFIG_PARTITION_TABLE_CUSTOM=y
CONFIG_PARTITION_TABLE_CUSTOM_FILENAME="partitions.csv"

# ── Power / CPU ───────────────────────────────────────────────────────────────
# 240 MHz for tight ISR timing
CONFIG_ESP32C3_DEFAULT_CPU_FREQ_160=y

# ── Watchdog ──────────────────────────────────────────────────────────────────
# Disable task watchdog interference during development
CONFIG_ESP_TASK_WDT_PANIC=n
CONFIG_ESP_INT_WDT=n
CONFIG_ESP_TASK_WDT_EN=n

# ── Zequencer MIDI defaults
CONFIG_ZEQ_MIDI_UART_PORT=1
CONFIG_ZEQ_MIDI_TX_GPIO=5

CONFIG_ESPTOOLPY_FLASHSIZE_4MB=y
CONFIG_ESPTOOLPY_FLASHSIZE="4MB"
```
